## legacy/rust/sdkconfig.defaults
```kconfig
CONFIG_IDF_TARGET="esp32s3"
CONFIG_BT_ENABLED=y
CONFIG_BT_BLUEDROID_ENABLED=n
CONFIG_BT_NIMBLE_ENABLED=y

CONFIG_BT_NIMBLE_ROLE_PERIPHERAL=y
CONFIG_BT_NIMBLE_ROLE_CENTRAL=n
CONFIG_BT_NIMBLE_ROLE_BROADCASTER=y
CONFIG_BT_NIMBLE_ROLE_OBSERVER=n

CONFIG_BT_CONTROLLER_ENABLED=y

# Minimise internal DRAM usage for NimBLE
CONFIG_BT_NIMBLE_MSYS_1_BLOCK_COUNT=12
CONFIG_BT_NIMBLE_ACL_BUF_COUNT=4
CONFIG_BT_NIMBLE_HCI_EVT_BUF_SIZE=70
CONFIG_BT_NIMBLE_ACL_BUF_SIZE=256
CONFIG_BT_NIMBLE_MAX_CCCD=4

CONFIG_BT_NIMBLE_LOG_LEVEL_INFO=y
CONFIG_BT_NIMBLE_MAX_CONNECTIONS=1

CONFIG_ESP_MAIN_TASK_STACK_SIZE=32768
CONFIG_BT_NIMBLE_HOST_TASK_STACK_SIZE=12288

# pthreads (Rust std::thread needs more stack for TLS init)
CONFIG_PTHREAD_TASK_STACK_SIZE_DEFAULT=8192
CONFIG_FREERTOS_THREAD_LOCAL_STORAGE_POINTERS=8

# WiFi
CONFIG_ESP_WIFI_ENABLED=y
CONFIG_ESP_WIFI_STATIC_RX_BUFFER_NUM=3
CONFIG_ESP_WIFI_DYNAMIC_RX_BUFFER_NUM=4
CONFIG_ESP_WIFI_TX_BUFFER_TYPE=1
CONFIG_ESP_WIFI_DYNAMIC_TX_BUFFER_NUM=4
CONFIG_ESP_WIFI_CACHE_TX_BUFFER_NUM=4
CONFIG_ESP_WIFI_AMPDU_TX_ENABLED=n
CONFIG_ESP_WIFI_AMPDU_RX_ENABLED=n
CONFIG_ESP_WIFI_MGMT_SBUF_NUM=4
CONFIG_ESP_WIFI_IRAM_OPT=y
CONFIG_ESP_WIFI_RX_IRAM_OPT=y

# ADC
# Disable brownout detector to prevent ESP32 reset during RMT/RF bursts
CONFIG_BROWNOUT_DET=n
CONFIG_ADC_CAL_EFUSE_VREF_ENABLE=y
CONFIG_ADC_DISABLE_DAC=y

# BT/WiFi Coexistence
CONFIG_ESP_COEX_ENABLED=y

# HTTP server — suppress WARN-level noise from client disconnects
CONFIG_HTTPD_LOG_LEVEL=1
CONFIG_ESP_HTTP_SERVER_LOG_LEVEL=1
CONFIG_HTTPD_WS_SUPPORT=y

# TCP/IP (LWIP)
CONFIG_LWIP_ENABLE_IPV6=n
CONFIG_LWIP_MAX_SOCKETS=8
CONFIG_ESP_NETIF_TCPIP_LWIP=y

# BLE GAP device name (overrides NimBLE default "nimble")
CONFIG_BT_NIMBLE_SVC_GAP_DEVICE_NAME="EcoTiter-"

# ESP32-S3 has a different memory layout — no BT controller DRAM overlap.
# The IRAM-as-DRAM workaround is not needed.

# Disable Interrupt Watchdog — NVS, WiFi, and BLE init legitimately disable
# interrupts for flash I/O longer than the 300ms IWDT timeout, causing
# TG1WDT_SYS_RST boot-loop. Task WDT is handled by disable_wdt() in esp_safe.rs.
CONFIG_ESP_INT_WDT=n

# PSRAM (8MB octal SPI RAM on ESP32-S3)
# All malloc() goes to PSRAM via SPIRAM_USE_MALLOC, freeing internal DRAM
# for WiFi/BLE DMA buffers (MALLOC_CAP_DMA) and task stacks.
# Internal DRAM reserved via SPIRAM_MALLOC_RESERVE_INTERNAL (32KB default).
CONFIG_SPIRAM=y
CONFIG_SPIRAM_MODE_OCT=y
CONFIG_SPIRAM_TYPE_AUTO=y
CONFIG_SPIRAM_USE_MALLOC=y
CONFIG_SPIRAM_MALLOC_RESERVE_INTERNAL=32768
# Move lwip/net80211/pp/bt BSS to PSRAM to free internal DRAM
CONFIG_SPIRAM_ALLOW_BSS_SEG_EXTERNAL_MEMORY=y
# WiFi/lwIP non-DMA allocations try PSRAM first, fall back to internal DRAM.
# DMA buffers (MALLOC_CAP_DMA) always go to internal DRAM regardless.
CONFIG_SPIRAM_TRY_ALLOCATE_WIFI_LWIP=y
```

## main/Kconfig.projbuild
```kconfig
menu "EcoTiter Configuration"

    config ECOTITER_ENABLE_BLE
        bool "Enable BLE support"
        default y
        help
            Enable Bluetooth Low Energy (NimBLE) interface.

    config ECOTITER_ENABLE_WIFI
        bool "Enable WiFi support"
        default y
        help
            Enable WiFi AP/STA and HTTP server.

    config ECOTITER_ENABLE_DIAG
        bool "Enable diagnostic subsystem"
        default y
        help
            Enable black box, stack monitor, tick watchdog.

endmenu
```

## sdkconfig.defaults
```kconfig
CONFIG_IDF_TARGET="esp32s3"
CONFIG_ESP_MAIN_TASK_STACK_SIZE=32768
# LL-038: System event task handles WiFi/IP event callbacks through the LogBuffer
# callback chain (ESP_LOGI → logVprintf → wsLogCallback → broadcastWsEvent → httpd).
# Each ESP_LOGI in this task adds ~2000 B of stack via the callback. Default 2304 B
# is insufficient — stack overflow when IP_EVENT_STA_GOT_IP fires during homing.
CONFIG_ESP_SYSTEM_EVENT_TASK_STACK_SIZE=8192
# IWDT (Interrupt Watchdog Timer) — catches spinlock deadlocks and
# interrupts-disabled-too-long conditions. Uses MWDT in Timer Group 1.
# When interrupts are disabled (portENTER_CRITICAL), the tick interrupt
# can't fire → IWDT timeout → panic with backtrace → stage 2 hard reset.
# LL-031/LL-032: This is the primary defense against silent GPIO spinlock
# deadlocks that TWDT cannot detect (interrupts disabled).
CONFIG_ESP_INT_WDT=y
CONFIG_ESP_INT_WDT_TIMEOUT_MS=500

# Brownout detector disabled — spurious resets during WiFi/BLE init high-current
# draws on 3.3V rail (ESP32-S3 + PSRAM + RGB LED burst). WDTs (IWDT/TWDT/RWDT)
# provide sufficient protection against true system hangs.
CONFIG_BROWNOUT_DET=n

# RWDT (RTC Watchdog) — ultimate protection against complete system hangs
# where even IWDT's panic handler cannot run. Keep bootloader's RWDT
# enabled and re-configure in app_main with 6s timeout → RESET_SYSTEM.
# Fed from main loop every 10ms.
CONFIG_BOOTLOADER_WDT_DISABLE_IN_USER_CODE=y
CONFIG_ESP_TASK_WDT_INIT=y
CONFIG_ESP_TASK_WDT_PANIC=y
CONFIG_ESP_TASK_WDT_TIMEOUT_S=10
CONFIG_FREERTOS_HZ=1000
CONFIG_FREERTOS_UNICORE=n
CONFIG_LOG_DEFAULT_LEVEL_INFO=y
# CONFIG_LOG_DEFAULT_LEVEL_WARN is not set
CONFIG_BOOTLOADER_LOG_LEVEL_ERROR=y
CONFIG_ESPTOOLPY_FLASHSIZE_16MB=y
# Explicit DIO flash mode — prevents stale-sdkconfig conflict with AUTO_DETECT (ref: boot crash 2026-07-11)
CONFIG_ESPTOOLPY_FLASHMODE_DIO=y
# CONFIG_ESP_CONSOLE_NONE is not set
CONFIG_ESP_CONSOLE_UART_DEFAULT=y

CONFIG_BT_ENABLED=y
CONFIG_BT_NIMBLE_ENABLED=y
CONFIG_BT_NIMBLE_HOST_TASK_STACK_SIZE=12288
CONFIG_BT_NIMBLE_ACL_BUF_COUNT=6
CONFIG_BT_NIMBLE_MSYS_1_BLOCK_COUNT=12
CONFIG_BT_NIMBLE_MAX_CCCDS=2
CONFIG_BT_NIMBLE_MAX_CONNECTIONS=1
CONFIG_BT_NIMBLE_MAX_BONDS=1

# Larger factory partition (1500K) for network-enabled firmware
CONFIG_PARTITION_TABLE_SINGLE_APP_LARGE=y

# WiFi / HTTP / LWIP
# Must be ≥ max_open_sockets(5) + httpd_internal(3) + DNS(1) + BLE/STA(2-3) = ~11
CONFIG_LWIP_MAX_SOCKETS=16
CONFIG_ESP_WIFI_DYNAMIC_RX_BUFFER_NUM=6
# Match RX BA window to dynamic RX buffer count (prevents wifi_init compile error)
CONFIG_ESP_WIFI_RX_BA_WIN=6
CONFIG_ESP_WIFI_DYNAMIC_TX_BUFFER_NUM=4
CONFIG_HTTPD_WS_SUPPORT=y
CONFIG_MDNS_MAX_SERVICES=1

# LL-038: HTTP server internal task — default 4096 is too small for WS + JSON

# PThread default stack (used by BLE notify thread via std::thread)
CONFIG_PTHREAD_TASK_STACK_SIZE_DEFAULT=8192

# PSRAM — ESP32-S3 has 8 MB octal PSRAM (Espressif ESP32-S3-DevKitC-1)
# Use PSRAM aggressively for heap allocations via caps, but keep DMA-critical
# and time-critical allocations in internal DRAM (MALLOC_CAP_INTERNAL).
CONFIG_SPIRAM=y
CONFIG_SPIRAM_MODE_OCT=y
CONFIG_SPIRAM_TYPE_AUTO=y
CONFIG_SPIRAM_ALLOW_BSS_SEG_EXTERNAL_MEMORY=y
CONFIG_SPIRAM_USE_CAPS_ALLOC=y
# [INVESTIGATION] Exp D: PSRAM code/data fetch disabled
# CONFIG_SPIRAM_FETCH_INSTRUCTIONS=y
# CONFIG_SPIRAM_RODATA=y
# Speed: 80 MHz for octal PSRAM on ESP32-S3
CONFIG_SPIRAM_SPEED_80M=y

# PSRAM for WiFi and LWIP — allocate WiFi/LWIP buffers in PSRAM first,
# fall back to internal DRAM if PSRAM is insufficient. This frees ~12 KB
# of internal DRAM for the HTTP server and BLE, resolving the DRAM
# fragmentation that blocked the captive portal (see GR-3).
CONFIG_SPIRAM_TRY_ALLOCATE_WIFI_LWIP=y

# Core dump to UART — binary ELF after panic header, captured by monitor.py
# Note: ESP_COREDUMP_DATA_FORMAT_ELF is auto-selected by ENABLE_TO_UART.
CONFIG_ESP_COREDUMP_ENABLE_TO_UART=y
```
